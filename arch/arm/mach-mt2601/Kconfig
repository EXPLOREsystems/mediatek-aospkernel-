## arch/arm/mach-mt2601/Kconfig
```kconfig
if ARCH_MT2601

menu "MT2601 Board Support Package"

choice
	bool "Board"

config MT2601_FPGA
	bool "MT2601 FPGA"
	select ARM_L1_CACHE_SHIFT_6
	help
	  Select if you are using the FPGA board.

config MT2601_EVB_BOARD
	bool "MT2601 EVB BOARD"
	select ARM_L1_CACHE_SHIFT_6
        help
          Select if you are using an EVB board.

endchoice

config MT2601_FPGA_CA7
	tristate "MT2601 FPGA CA7"
	depends on MT2601_FPGA
	default n
	help
	    Select if you are using the CA7 FPGA board.

config MAX_DRAM_SIZE_SUPPORT
	hex "The maximum size of the DRAM can be supported in the kernel"
	default 0x10000000
	depends on ARCH_MT2601
	help
		Define the maximum size of the kernel can be supported.
	        If will modify the memory size if it size is smaller than
                the memory size passed by the boot loader to the MAX_DRAM_SIZE_SUPPORT.
   		Notice that the maximum DRAM size is including the memory size
	        reserved for the modem and the PMEM.
endmenu


endif
```
